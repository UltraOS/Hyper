ENTRY(main)

SECTIONS
{
    . = 0xFFFFFFFF80000000; /* MAX - 2GB */

    .text :
    {
        *(.text .text.*)
    }

    .rodata :
    {
        *(.rodata .rodata.*)
    }

    .data :
    {
        *(.data .data.*)
    }

    .bss :
    {
        *(COMMON)
        *(.bss .bss.*)
    }
}